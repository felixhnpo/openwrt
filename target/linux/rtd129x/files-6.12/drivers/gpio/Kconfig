## target/linux/rtd129x/files-6.12/drivers/gpio/Kconfig
```kconfig
# SPDX-License-Identifier: GPL-2.0-only

config GPIO_RTD129x
	tristate "Realtek RTD129x GPIO support"
	depends on ARCH_RTD129X || COMPILE_TEST
	select GPIOLIB
	help
	  This driver supports the GPIO controller found in Realtek RTD129x SoCs.

	  To compile this driver as a module, choose M here. The module
	  will be called gpio-rtd129x.
```

## target/linux/rtd129x/files-6.12/drivers/net/ethernet/realtek/Kconfig
```kconfig
# SPDX-License-Identifier: GPL-2.0-only

config R8169SOC
	tristate "Realtek RTD129x SoC Gigabit Ethernet driver"
	depends on ARCH_RTD129X || COMPILE_TEST
	select PHYLIB
	help
	  This driver supports the integrated Gigabit Ethernet controller
	  found in Realtek RTD129x SoCs (RTD1294, RTD1295, RTD1296).

	  To compile this driver as a module, choose M here. The module
	  will be called r8169soc.
```
